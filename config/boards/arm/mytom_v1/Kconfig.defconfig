## config/boards/arm/mytom_v1/Kconfig.defconfig
```kconfig
# Copyright (c) 2021 The ZMK Contributors
# SPDX-License-Identifier: MIT

if BOARD_MYTOM_V1_LEFT
    config ZMK_KEYBOARD_NAME 
	default "Mytom Left v1"

config ZMK_SPLIT_ROLE_CENTRAL
	default y
	
if ZMK_DISPLAY

config SPI
	default y

config ST7789V
	default y

choice ST7789V_PIXEL_FORMAT
	default ST7789V_RGB888
endchoice

config LVGL_Z_BITS_PER_PIXEL
	default 24 


endif # ZMK_DISPLAY

endif #BOARD_MYTOM_V1_LEFT

if BOARD_MYTOM_V1_RIGHT
    config ZMK_KEYBOARD_NAME
	default "Mytom Right v1"
endif #BOARD_MYTOM_V1_RIGHT


if BOARD_MYTOM_V1_LEFT || BOARD_MYTOM_V1_RIGHT

config BOARD
	default "Mytom"

config ZMK_SPLIT
	default y

if USB

config USB_NRFX
	default y

config USB_DEVICE_STACK
	default y

endif # USB

config BT_CTLR
	default BT

config ZMK_BLE
	default y

config ZMK_USB
	default y

config ZMK_BATTERY_VOLTAGE_DIVIDER
	default y

endif 
```

## config/boards/arm/nemm/Kconfig.board
```kconfig
# Copyright (c) 2021 The ZMK Contributors
# SPDX-License-Identifier: MIT

config BOARD_NEMM_V1_LEFT
	bool "nemm v1 left"
	depends on SOC_NRF52840_QIAA
config BOARD_NEMM_V1_RIGHT 
    bool "nemm v1 right"
	depends on SOC_NRF52840_QIAA
```
